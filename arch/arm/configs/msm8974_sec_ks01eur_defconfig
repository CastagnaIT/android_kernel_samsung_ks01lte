## arch/arm/configs/msm8974_sec_ks01eur_defconfig
```kconfig
#KS01 PROJECT config
CONFIG_SEC_KS01_PROJECT=y
CONFIG_SEC_LOCALE_KOR=y
CONFIG_MACH_KS01SKT=y
CONFIG_MACH_KS01EUR=y
CONFIG_MSM_ADSPRPC=y

CONFIG_DEFERRED_INITCALLS=y

#
# Wifi features
#
#
# Remove Qualcomm Wifi features
#
# CONFIG_WCNSS_CORE is not set
# CONFIG_WCNSS_CORE_PRONTO is not set
# CONFIG_WCNSS_MEM_PRE_ALLOC is not set
#
# Wifi features (Broadcomm)
#
CONFIG_NET_CORE=y
CONFIG_WIRELESS=y
CONFIG_WIRELESS_EXT_SYSFS=y
CONFIG_WEXT_CORE=y
CONFIG_WEXT_PROC=y
CONFIG_CFG80211=y
CONFIG_CFG80211_DEFAULT_PS=y
CONFIG_CFG80211_ALLOW_RECONNECT=y
CONFIG_WLAN=y
CONFIG_WIFI_CONTROL_FUNC=y
CONFIG_BCM4335=y
CONFIG_BCMDHD_FW_PATH="/system/etc/wifi/bcmdhd_sta.bin"
CONFIG_BCMDHD_NVRAM_PATH="/system/etc/wifi/nvram_net.txt"
CONFIG_BROADCOM_WIFI_RESERVED_MEM=y
CONFIG_WLAN_REGION_CODE=100
CONFIG_MMC_MSM_SDC2_SUPPORT=y
CONFIG_MMC_MSM_SDC3_SUPPORT=y
CONFIG_CFG80211_REG_NOT_UPDATED=y
CONFIG_WIFI_MULTICAST_LOG=y

# CONFIG_MSM_PIL_PRONTO is not set
#
# LCD
#
CONFIG_LCD_CLASS_DEVICE=y
CONFIG_BACKLIGHT_LCD_SUPPORT=y
CONFIG_BACKLIGHT_CLASS_DEVICE=y
CONFIG_MDNIE_LITE_TUNING=y
CONFIG_FB_MSM_MIPI_SAMSUNG_OCTA_VIDEO_FULL_HD_PT_PANEL=y

#
# Camera
#
CONFIG_IMX135=y

#
# Actuator
#
CONFIG_I2C_ACTUATOR=y

#
# Input
#
CONFIG_TOUCHSCREEN_SYNAPTICS_I2C_RMI_S5000=y
CONFIG_KEYBOARD_CYPRESS_TOUCH=y
CONFIG_KEYBOARD_CYPRESS_TOUCHKEY_KS01=y

#
# Specific keyboard combination reject in kernel level.
# Only processing Framework level.
#
CONFIG_USE_VM_KEYBOARD_REJECT=y

#
# Audience
#
CONFIG_SND_SOC_ES325=y
CONFIG_SND_SOC_ES325_SLIM=y
CONFIG_FW_LOADER=y
CONFIG_FIRMWARE_IN_KERNEL=y
CONFIG_EXTRA_FIRMWARE="audience-es325-fw-KS01-eur.bin"
CONFIG_EXTRA_FIRMWARE_DIR="firmware"

#
# BT Call Forwarding
#
CONFIG_BT_CALL_FORWARDING=y

#
# DHA Solution
#
CONFIG_SEC_DHA_SOL_MAL=y

#
# usb
#
CONFIG_USB_DUN_SUPPORT=y
CONFIG_USB_XHCI_HCD=y
# CONFIG_USB_EHCI_EHSET is not set
# CONFIG_USB_EHCI_MSM is not set
# CONFIG_USB_EHCI_MSM_HSIC is not set
CONFIG_USB_DWC3=y
CONFIG_USB_DWC3_MSM=y
CONFIG_MHL_VERSION=0x20

CONFIG_USB_STORAGE_DETECT=y
CONFIG_USB_HOST_NOTIFY=y
CONFIG_USB=y

CONFIG_USB_PRINTER=y

#
# Advanced Linux Sound Architecture
#
CONFIG_SND_RAWMIDI=y

#
# Enable SEC_PM Feature
#
CONFIG_SEC_PM=y
CONFIG_SEC_PM_DEBUG=y
CONFIG_REGULATOR_MAX77803=y

# CONFIG_SENSORS_ADSP is not set
#
# Sensor hub
#
CONFIG_SENSORS_SSP=y
CONFIG_SENSORS_SYSFS=y
CONFIG_SENSORS_SSP_FACTORY=y
CONFIG_SENSORS_SSP_MPU6500=y
CONFIG_SENSORS_SSP_BMP182=y
CONFIG_SENSORS_SSP_ATUC128L5HAR=y
CONFIG_SENSORS_SSP_SENSORHUB=y
CONFIG_SENSORS_SSP_SHTC1=y
CONFIG_SENSORS_SSP_ATMEL=y
CONFIG_SENSORS_SSP_CM3320=y
CONFIG_SENSORS_SSP_MAX88920=y
CONFIG_SENSORS_SSP_YAS532=y
CONFIG_IIO_BUFFER=y
CONFIG_IIO=y
CONFIG_IIO_KFIFO_BUF=y
CONFIG_IIO_TRIGGER=y
CONFIG_IIO_ST_HWMON=y

#
# NFC
#
CONFIG_BCM2079X_NFC_I2C=y

#
# Battery & Charger
#
CONFIG_BATTERY_SAMSUNG=y
CONFIG_SAMSUNG_LPM_MODE=y

#
# MAX77803 Charger
#
CONFIG_FUELGAUGE_MAX17048=y
CONFIG_CHARGER_MAX77803=y
# CONFIG_BATTERY_SWELLING is not set

#
# Misc module
#
CONFIG_SEC_FPGA=y
CONFIG_IR_REMOCON_FPGA=y
CONFIG_SENSORS_HALL=y
CONFIG_REGULATOR_MAX77803=y
CONFIG_MFD_MAX77803=y
CONFIG_MAX77803_MUIC=y
CONFIG_MUIC_MAX77803_SUPPORT_MHL_CABLE_DETECTION=y
CONFIG_LEDS_AN30259A=y
CONFIG_MOTOR_DRV_MAX77803=y
CONFIG_SS_VIBRATOR=y
# CONFIG_TACTILE_ASSIST is not set
CONFIG_LEDS_MAX77803=y

#
# etc
#
CONFIG_HID=y
# CONFIG_HID_OVR is not set
#
# BT
#
CONFIG_BT_BCM4335=y

#
# extcon
#
# CONFIG_EXTCON is not set

#
# RCU
#
CONFIG_RCU_FAST_NO_HZ=y

#EPDG
CONFIG_NET_CORE=y
CONFIG_NET_SCH_PRIO=y
CONFIG_NET_SCHED=y   #depends on CONFIG_NET  which is enabled by default.. coz not seeing in the config file
CONFIG_NET_CLS_BASIC=y # required if basic is being used as a filter. depends on CONFIG_NET_CLS so enabling it by default
CONFIG_NET_CLS=y
CONFIG_NET_CLS_ACT=y # for enabling the action target.
CONFIG_NET_ACT_MIRRED=y  # for enabling the mirred target for redirecting the packet between the devices.
CONFIG_NET_EMATCH=y   #basic uses extended matches so this has to be present
CONFIG_NET_SCH_INGRESS=y # classifier for ingress packet

#optimize mmc block delay on resume
CONFIG_MMC_BLOCK_DEFERRED_RESUME=y


# SAMP : HOTNESS
CONFIG_SAMP_HOTNESS=y

# DUALWAVE
CONFIG_DUALWAVE=y
```
